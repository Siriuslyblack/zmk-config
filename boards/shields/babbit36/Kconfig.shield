## boards/shields/babbit36/Kconfig.shield
```kconfig
config BABBIT36
    def_bool $(shields_list_contains,babbit36)
config BABBIT36_DONGLE
    def_bool $(shields_list_contains,babbit36_dongle)
```

## config/boards/shields/babbit36/Kconfig.defconfig
```kconfig
if BABBIT36_DONGLE

config ZMK_KEYBOARD_NAME
	default "babbit36"

config ZMK_SPLIT_ROLE_CENTRAL
	default y

config ZMK_SPLIT
	default y

config ZMK_SPLIT_BLE_CENTRAL_PERIPHERALS
	default 1

config BT_MAX_CONN
	default 4

config BT_MAX_PAIRED
	default 4

endif

if BABBIT36

config ZMK_KEYBOARD_NAME
	default "babbit36"

config SPI
	default y

endif
```
